#include "k210.h"

/* ==========================================================================
 *  K210 视觉数据接收与解析
 * ==========================================================================
 *  调用链（自上而下）：
 *      K210 串口发帧
 *        -> USART3 逐字节接收
 *        -> DMA1_Channel3 自动搬进 k210_buffer[30]（全程不占 CPU）
 *        -> 总线连续空闲 1 个字符时间，触发 IDLE 中断
 *        -> HAL_UARTEx_RxEventCallback()（在 main.c）
 *        -> 对本次收到的每个字节调用 k210_data_callback()（本文件）
 *        -> 攒满 13 字节 + 帧尾正确 + BCC 正确 -> 整帧拷进全局 k210
 *
 *  为什么用"逐字节状态机"而不是"整块比较"：
 *      DMA 一次可能只收到半帧，也可能一次收到两三帧（K210 发送很快、
 *      帧与帧之间没有间隔时）。逐字节喂入可以跨多次调用拼装，
 *      天然适应任意切分方式，鲁棒性最好。
 *
 *  为什么不用环形缓冲队列：
 *      一帧只有 13 字节，解析只需几十个周期；全局 k210 表达的是
 *      "最新一帧"的语义，控制环也只关心最新目标，丢掉旧帧反而更合理。
 *      将来若需要历史帧，再改成环形队列即可。
 * ========================================================================== */

/**
  * @brief  计算 BCC 异或校验值
  * @param  data   待校验数据的首地址
  * @param  length 参与校验的字节数（不含 BCC 自身与帧尾）
  * @retval 逐字节异或的结果
  * @note   异或校验实现只需一条指令、无需查表，能 100% 检出单比特错误
  *         和任意奇数个比特翻转；对"同时两个比特翻转"无能为力。
  *         串口误码以单比特为主，因此够用且开销最小。
  */
unsigned char calculateBCC(const unsigned char *data, uint16_t length) {
    unsigned char bcc = 0;
    uint16_t i = 0;
    for (i = 0; i < length; i++) {
        bcc ^= data[i];                 /* 初值 0，逐字节异或 */
    }
    return bcc;
}

K210_Recvmsg k210;                      /* 全局最新一帧：解析成功后整帧覆盖 */

/**
  * @brief  逐字节组帧：每收到 1 个字节调用一次
  * @param  recv 本次收到的字节
  * @retval 1 = 刚刚成功解析出一帧完整数据；0 = 还在攒帧或校验失败
  * @note   本函数由 main.c 的 HAL_UARTEx_RxEventCallback() 在中断上下文调用，
  *         所以内部绝对不能有阻塞操作，也不要调用 printf。
  *         返回值目前主循环未使用（数据已直接写入全局 k210），
  *         保留它是为了将来改成事件/回调式使用时不必修改接口。
  */
uint8_t k210_data_callback(uint8_t recv)
{
    static uint8_t recvlen = sizeof(k210);      /* 一帧应有字节数 = 13，随结构体自动变化 */
    static uint8_t recv_data[sizeof(k210)];     /* 攒帧临时缓冲；static 保证跨调用保持内容 */
    static uint8_t recv_counts = 0;             /* 已攒字节数，同时充当写指针下标 */

    uint8_t data_ready = 0;                     /* 本次调用是否凑齐并校验通过一帧 */

    /* ---------- 第 1 步：先落盘 ----------
       先写入再判断，是这段代码的一个细节：
       由于 recv_counts 一旦等于 13 就会在下面被清零，此处最大写索引恰为 12，
       正好落在 recv_data[0..12] 范围内，不越界（属于"擦边安全"）。
       注意：如果以后把 recvlen 改大、或结构体增加字段，必须改成
       "先判边界再写"，否则会写穿数组、踩坏相邻的静态变量。 */
    recv_data[recv_counts] = recv;

    /* ---------- 第 2 步：帧同步（决定计数怎么走） ----------
       只有两种情况下才继续计数：
         1) 收到帧头 0xCC        -> 说明新的一帧开始
         2) recv_counts > 0      -> 说明已经在帧内，继续往后收
       其余情况（空闲态收到非帧头字节）直接丢弃，保持等待帧头。 */
    if (recv == K210_HEAD || recv_counts > 0)
        recv_counts++;
    else
        recv_counts = 0;

    /* ---------- 第 3 步：收满 13 字节，做合法性检查 ---------- */
    if (recv_counts == recvlen)
    {
        recv_counts = 0;                        /* 无论成功失败都先清零，为下一帧做准备 */

        if (recv_data[recvlen - 1] == K210_END) /* 检查 1：末字节必须是帧尾 0xDD */
        {
            /* 检查 2：BCC 校验。
               参与校验的是下标 0~10（Head .. size）共 11 字节，
               待比对的校验值在下标 11，帧尾在下标 12。
               因此校验长度与校验值下标都是 recvlen-2 = 11，正好对应。 */
            if (recv_data[recvlen - 2] == calculateBCC(recv_data, recvlen - 2))
            {
                /* 两项检查都通过 -> 把临时缓冲整体搬到全局结构体。
                   这里用指针逐字节拷贝而不是 memcpy：
                   pack(1) 结构体的成员可能未对齐，逐字节拷贝不会有
                   对齐异常，也不引入库函数开销。 */
                uint8_t *recvptr = (uint8_t *)&k210;
                for (uint8_t i = 0; i < recvlen; i++)
                {
                    *recvptr = recv_data[i];
                    recvptr++;
                }
                /* 走到这里，k210 里已经是一帧完整可信的数据，
                   主循环可以安全读取（cx/cy/size 供显示与上报）。 */
                data_ready = 1;
            }
            /* 校验失败：静默丢弃这一帧，等下一个帧头。
               不做重传/请求，因为视觉数据流是持续刷新的，
               丢一帧对控制几乎没有影响，重传反而增加复杂度。 */
        }
    }

    return data_ready;
}
